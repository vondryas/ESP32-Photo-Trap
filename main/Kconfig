## main/Kconfig
```kconfig
menu "LoRaWAN Configuration"
    config DevEUI
        string "DevEUI"
        default "0000000000000000"
        help
            Enter your DevEUI from The Things Network
 
    config AppEUI
        string "AppEUI"
        default "0000000000000000"
        help
            Enter your AppEUI (JoinEUI) from The Things Network

    config AppKey
        string "AppKey"
        default "00000000000000000000000000000000"
        help
            Enter your AppKey from The Things Network
endmenu
```
